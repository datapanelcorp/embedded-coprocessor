## CMakeLists.txt
```
cmake_minimum_required(VERSION 3.20.0)

# Use the application's native_sim stand-ins for the ECP hardware
set(DTC_OVERLAY_FILE ${CMAKE_CURRENT_SOURCE_DIR}/../../boards/native_sim.overlay)

find_package(Zephyr REQUIRED HINTS $ENV{ZEPHYR_BASE})
project(ecp_reboot_test)

set(APP_DIR ${CMAKE_CURRENT_SOURCE_DIR}/../..)
set(COMMANDS_TEST_DIR ${CMAKE_CURRENT_SOURCE_DIR}/../commands)

# Code under test
target_sources(app PRIVATE ${APP_DIR}/src/commands.c ${APP_DIR}/src/bindesc_dp.c)

# The commands test provides test_main() and the helpers
target_sources(app PRIVATE ${COMMANDS_TEST_DIR}/src/main.c src/main.c)
target_include_directories(app PRIVATE ${COMMANDS_TEST_DIR}/src)

target_sources(app PRIVATE ${ZEPHYR_DPUNITY_MODULE_DIR}/ztest/common/ecp_sim_host/ecp_sim_host.c)
target_include_directories(app PRIVATE ${ZEPHYR_DPUNITY_MODULE_DIR}/ztest/common/ecp_sim_host)
```

## Kconfig
```
config TEST_ECP_REBOOT_COMMAND
	hex "Command to test"
	default 0x0005
	help
	  ECP_CMD_REBOOT (0x0005) or ECP_CMD_BOOT_JUMP (0x0009)

config TEST_ECP_REBOOT_WHEN_ACTIVE
	bool "Enumerate before rebooting"
	help
	  Send ENUM first, so the command is tested in the active state.

rsource "../commands/Kconfig"
```

## prj.conf
```kconfig
CONFIG_ZTEST=y

CONFIG_ECP_DEVICE_CMD_BACKEND_SIMULATOR=y
CONFIG_ECP_DEVICE_CMD_DEDICATED_THREAD=y
CONFIG_ECP_DEVICE_CMD_IN_PROGRESS_STATUS=y

CONFIG_GPIO=y
CONFIG_EVENTS=y
# The test provides sys_reboot()
CONFIG_REBOOT=n
CONFIG_DP_METRICS=y

CONFIG_BINDESC=y
CONFIG_BINDESC_DEFINE=y
CONFIG_BINDESC_DEFINE_VERSION=y
CONFIG_BINDESC_DP_SW_PART_NUMBER=y

# Match the application: the port handler thread is started by ENUM
CONFIG_DP_PORTS_HANDLER_DEDICATED_THREAD=n
```

## src/main.c
```c
/*
 * REBOOT and BOOT_JUMP. These can't return, so each gets its own test binary.
 */
#include <zephyr/ztest.h>
#include <zephyr/sys/reboot.h>

#include <dp/drivers/port_fake.h>

#include "ecp_test.h"

#define COMMAND CONFIG_TEST_ECP_REBOOT_COMMAND

static struct ecp_sim_response resp;

static K_SEM_DEFINE(rebooted, 0, 1);
static int reboot_type = -1;

/* Port calls made before the reboot */
static unsigned int pauses_before_reboot;
static unsigned int sensor_power_offs_before_reboot;

/* Replaces the real sys_reboot(). The calling thread never returns, as if the ECP had
 * restarted.
 */
FUNC_NORETURN void sys_reboot(int type)
{
	reboot_type = type;
	pauses_before_reboot = port_fake_pause_fake.call_count;
	for (unsigned int i = 0; i < port_fake_set_sensor_power_fake.call_count &&
				 i < FFF_ARG_HISTORY_LEN;
	     i++) {
		if (port_fake_set_sensor_power_fake.arg2_history[i] == 0) {
			sensor_power_offs_before_reboot++;
		}
	}
	k_sem_give(&rebooted);

	while (true) {
		k_sleep(K_FOREVER);
	}
}

ZTEST(ecp_reboot, test_1_reboots)
{
	BUILD_ASSERT(COMMAND == ECP_CMD_REBOOT || COMMAND == ECP_CMD_BOOT_JUMP);

	if (IS_ENABLED(CONFIG_TEST_ECP_REBOOT_WHEN_ACTIVE)) {
		struct ecp_request_enum q = {.ecp_type = ECP_TEST_ENUM_TYPE, .ecp_revision = 2};

		ecp_test_expect(ECP_CMD_ENUM, 1, &q, sizeof(q), ECP_RES_SUCCESS, &resp);
		port_fake_reset();
	}

	ecp_test_expect(COMMAND, 1, NULL, 0, ECP_RES_IN_PROGRESS, &resp);

	zassert_ok(k_sem_take(&rebooted, K_SECONDS(1)), "Did not reboot");
	zassert_equal(reboot_type, SYS_REBOOT_COLD);

	/* Everything ESTOP does happens first: each channel paused, and its sensor power off */
	if (IS_ENABLED(CONFIG_TEST_ECP_REBOOT_WHEN_ACTIVE)) {
		zassert_equal(pauses_before_reboot, ECP_TEST_NUM_CHANNELS);
		zassert_equal(sensor_power_offs_before_reboot, ECP_TEST_NUM_CHANNELS);
	} else {
		zassert_equal(pauses_before_reboot, 0);
	}
}

/* Spec: BUSY if a conflicting command is still pending. Here, the reboot never
 * finishes, so another long-running command can't start.
 */
ZTEST(ecp_reboot, test_2_estop_while_pending)
{
	ecp_test_expect(ECP_CMD_ESTOP, 1, NULL, 0, ECP_RES_BUSY, &resp);
}

/* REBOOT and BOOT_JUMP are available in both states. The suite runs in the unconfigured
 * phase, and the .active scenarios send ENUM first.
 */
ZTEST_SUITE(ecp_reboot, ecp_phase_unconfigured, NULL, NULL, NULL, NULL);
```
