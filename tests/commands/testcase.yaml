## tests/commands/testcase.yaml
```yaml
common:
  platform_allow:
    - native_sim
  integration_platforms:
    - native_sim
  tags: ecp_device_cmd

tests:
  ecp.app.commands: {}
  ecp.app.commands.13a:
    extra_configs:
      - CONFIG_TEST_ECP_ENUM_13A=y
  ecp.app.commands.led:
    extra_configs:
      - CONFIG_LED=y
  ecp.app.commands.minimal:
    extra_configs:
      - CONFIG_APP_ECP_PEEK_POKE=n
      - CONFIG_APP_ECP_GPIO=n
      - CONFIG_APP_ECP_COMM_STATS=n
```

## tests/host/testcase.yaml
```yaml
common:
  platform_allow:
    - native_sim
  integration_platforms:
    - native_sim
  tags: ecp_device_cmd

tests:
  ecp.app.host: {}
```

## tests/reboot/testcase.yaml
```yaml
common:
  platform_allow:
    - native_sim
  integration_platforms:
    - native_sim
  tags: ecp_device_cmd

tests:
  ecp.app.reboot:
    extra_configs:
      - CONFIG_TEST_ECP_REBOOT_COMMAND=0x0005
  ecp.app.boot_jump:
    extra_configs:
      - CONFIG_TEST_ECP_REBOOT_COMMAND=0x0009
```
