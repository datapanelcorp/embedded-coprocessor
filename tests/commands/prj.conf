## CMakeLists.txt
```
cmake_minimum_required(VERSION 3.20.0)

# Use the application's native_sim stand-ins for the ECP hardware
set(DTC_OVERLAY_FILE ${CMAKE_CURRENT_SOURCE_DIR}/../../boards/native_sim.overlay)

find_package(Zephyr REQUIRED HINTS $ENV{ZEPHYR_BASE})
project(ecp_commands_test)

set(APP_DIR ${CMAKE_CURRENT_SOURCE_DIR}/../..)

# Code under test
target_sources(app PRIVATE ${APP_DIR}/src/commands.c ${APP_DIR}/src/bindesc_dp.c)

target_sources(app PRIVATE
  src/main.c
  src/test_system.c
  src/test_unconfigured.c
  src/test_enum.c
  src/test_io.c
  src/test_estop.c
)
target_sources_ifdef(CONFIG_APP_ECP_GPIO app PRIVATE src/test_gpio.c)
target_sources_ifdef(CONFIG_TASK_WDT app PRIVATE ${APP_DIR}/src/watchdog.c src/test_watchdog.c)
if(CONFIG_APP_ECP_HOST_TIMEOUT_MS GREATER 0)
  target_sources(app PRIVATE src/test_inactivity.c)
endif()
target_sources_ifdef(CONFIG_APP_ECP_PEEK_POKE app PRIVATE src/test_peek_poke.c)
target_sources_ifdef(CONFIG_APP_ECP_LED app PRIVATE src/test_led.c)

target_sources(app PRIVATE ${ZEPHYR_DPUNITY_MODULE_DIR}/ztest/common/ecp_sim_host/ecp_sim_host.c)
target_include_directories(app PRIVATE ${ZEPHYR_DPUNITY_MODULE_DIR}/ztest/common/ecp_sim_host)
```

## Kconfig
```
config TEST_ECP_KNOWN_DEVIATIONS
	bool "Run tests for known deviations from the ECP specification"
	help
	  Tests for behavior that doesn't yet match the ECP protocol
	  specification. They fail until the deviation is fixed, so by default
	  they're skipped.

config TEST_ECP_ENUM_13A
	bool "Enumerate as a 13A DO_DI port"
	help
	  Enumerate as ECP_TYPE_DO_DI_13A instead of ECP_TYPE_DO_DI_5A.

# The application's options (APP_ECP_*), which also sources Kconfig.zephyr
rsource "../../Kconfig"
```

## prj.conf
```kconfig
CONFIG_ZTEST=y

CONFIG_ECP_DEVICE_CMD_BACKEND_SIMULATOR=y
CONFIG_ECP_DEVICE_CMD_DEDICATED_THREAD=y
CONFIG_ECP_DEVICE_CMD_IN_PROGRESS_STATUS=y

CONFIG_GPIO=y
CONFIG_EVENTS=y
CONFIG_REBOOT=y
CONFIG_DP_METRICS=y

CONFIG_BINDESC=y
CONFIG_BINDESC_DEFINE=y
CONFIG_BINDESC_DEFINE_VERSION=y
CONFIG_BINDESC_DP_SW_PART_NUMBER=y

# Match the application: the port handler thread is started by ENUM
CONFIG_DP_PORTS_HANDLER_DEDICATED_THREAD=n
```

## src/main.c
```c
/*
 * Tests for the ECP command handlers in src/commands.c. Requests go through the real
 * device command handler via the simulator backend; the ports are fakes.
 */
#include <zephyr/ztest.h>
#include <zephyr/fff.h>

#include <dp/ecp/ecp_device_cmd/ecp_device_cmd.h>

#include "ecp_test.h"

DEFINE_FFF_GLOBALS;

static bool in_phase(const void *state, enum ecp_test_phase phase)
{
	const struct ecp_test_state *s = state;

	return s != NULL && s->phase == phase;
}

bool ecp_phase_unconfigured(const void *state)
{
	return in_phase(state, ECP_PHASE_UNCONFIGURED);
}

bool ecp_phase_enum(const void *state)
{
	return in_phase(state, ECP_PHASE_ENUM);
}

bool ecp_phase_active(const void *state)
{
	return in_phase(state, ECP_PHASE_ACTIVE);
}

bool ecp_phase_estop(const void *state)
{
	return in_phase(state, ECP_PHASE_ESTOP);
}

bool ecp_phase_any(const void *state)
{
	return ecp_phase_unconfigured(state) || ecp_phase_active(state);
}

void ecp_test_expect(uint16_t command, uint8_t version, const void *data, uint16_t data_len,
		     enum ecp_result_code expected, struct ecp_sim_response *resp)
{
	enum ecp_result_code result =
		ecp_sim_host_transact(command, version, data, data_len, resp);

	zassert_equal(result, expected, "Command 0x%04x v%u: expected result %d, got %d",
		      command, version, expected, result);
	if (result != ECP_RES_SUCCESS && result != ECP_RES_IN_PROGRESS) {
		zassert_equal(resp->data_len, 0, "Error response has %u data bytes",
			      resp->data_len);
	}
}

void ecp_test_expect_in_progress_result(enum ecp_result_code expected)
{
	for (int i = 0; i < 100 && !ecp_device_cmd_send_in_progress_ended(); i++) {
		k_msleep(1);
	}
	zassert_true(ecp_device_cmd_send_in_progress_ended(), "Command did not finish");

	enum ecp_result_code result = ecp_device_cmd_send_in_progress_status();
	zassert_equal(result, expected, "Expected final result %d, got %d", expected, result);
}

static void *ecp_host_setup(void)
{
	ecp_sim_host_init();
	return NULL;
}

void test_main(void)
{
	struct ecp_test_state state;

	ecp_host_setup();

	for (enum ecp_test_phase phase = ECP_PHASE_UNCONFIGURED; phase <= ECP_PHASE_ESTOP;
	     phase++) {
		state.phase = phase;
		ztest_run_all(&state, false, 1, 1);
	}

	ztest_verify_all_test_suites_ran();
}
```

## src/ecp_test.h
```c
#ifndef ECP_TEST_H_
#define ECP_TEST_H_

#include <zephyr/device.h>
#include <zephyr/ztest.h>

#include <dp/ecp/protocol.h>

#include "ecp_sim_host.h"

/*
 * The ECP starts unconfigured and becomes active after ENUM, which can't be undone
 * without a reboot. test_main() runs the suites in phases, and each suite's predicate
 * selects the phases it runs in.
 */
enum ecp_test_phase {
	ECP_PHASE_UNCONFIGURED,
	ECP_PHASE_ENUM,
	ECP_PHASE_ACTIVE,
	/* Last, because ESTOP returns the ECP to the unconfigured state */
	ECP_PHASE_ESTOP,
};

struct ecp_test_state {
	enum ecp_test_phase phase;
};

bool ecp_phase_unconfigured(const void *state);
bool ecp_phase_enum(const void *state);
bool ecp_phase_active(const void *state);
bool ecp_phase_estop(const void *state);
/* Both unconfigured and active, for commands available in either state */
bool ecp_phase_any(const void *state);

/* The port that ENUM activates */
#if defined(CONFIG_TEST_ECP_ENUM_13A)
#define ECP_TEST_ENUM_TYPE ECP_TYPE_DO_DI_13A
#define ECP_TEST_PORT      DEVICE_DT_GET(DT_NODELABEL(port1_13a))
#define ECP_TEST_OTHER_PORT DEVICE_DT_GET(DT_NODELABEL(port1_5a))
#else
#define ECP_TEST_ENUM_TYPE ECP_TYPE_DO_DI_5A
#define ECP_TEST_PORT      DEVICE_DT_GET(DT_NODELABEL(port1_5a))
#define ECP_TEST_OTHER_PORT DEVICE_DT_GET(DT_NODELABEL(port1_13a))
#endif

#define ECP_TEST_NUM_CHANNELS 2

/**
 * Skip the rest of the test unless CONFIG_TEST_ECP_KNOWN_DEVIATIONS is set. Use at the
 * start of a test that checks behavior required by the spec but not yet implemented.
 */
#define ECP_KNOWN_DEVIATION(_why)                                                                  \
	do {                                                                                       \
		if (!IS_ENABLED(CONFIG_TEST_ECP_KNOWN_DEVIATIONS)) {                               \
			TC_PRINT("Known deviation from spec: %s\n", _why);                         \
			ztest_test_skip();                                                         \
		}                                                                                  \
	} while (0)

/**
 * Send a request and check the response's result code
 */
void ecp_test_expect(uint16_t command, uint8_t version, const void *data, uint16_t data_len,
		     enum ecp_result_code expected, struct ecp_sim_response *resp);

/**
 * Wait for the command that returned ECP_RES_IN_PROGRESS to finish, and check its
 * final result
 */
void ecp_test_expect_in_progress_result(enum ecp_result_code expected);

#endif /* ECP_TEST_H_ */
```

## src/test_enum.c
```c
/*
 * ENUM: the transition from the unconfigured to the active state
 */
#include <zephyr/ztest.h>

#include <dp/drivers/port.h>
#include <dp/drivers/port_fake.h>

#include "ecp_test.h"

static struct ecp_sim_response resp;

ZTEST(ecp_enum, test_enum)
{
	struct ecp_request_enum q = {
		.offset = 0,
		.ecp_type = ECP_TEST_ENUM_TYPE,
		.ecp_revision = 2,
	};

	ecp_test_expect(ECP_CMD_ENUM, 1, &q, sizeof(q), ECP_RES_SUCCESS, &resp);
	zassert_equal(resp.data_len, 0);

	zassert_true(device_is_ready(DEVICE_DT_GET(DT_NODELABEL(port))),
		     "Port controller not initialized");
	zassert_true(device_is_ready(ECP_TEST_PORT), "Port not initialized");
	zassert_false(device_is_ready(ECP_TEST_OTHER_PORT), "Wrong port initialized");
	zassert_equal(port_channel_count(PORT_1), ECP_TEST_NUM_CHANNELS);

	/* The port handler applies the default configuration, then polls every channel */
	k_msleep(2 * CONFIG_DP_PORTS_POLL_PERIOD);
	zassert_true(port_fake_set_attribute_fake.call_count > 0, "Port not configured");
	zassert_true(port_fake_poll_fake.call_count >= ECP_TEST_NUM_CHANNELS, "Port not polled");
	zassert_equal(port_fake_poll_fake.arg0_val, ECP_TEST_PORT);
}

ZTEST_SUITE(ecp_enum, ecp_phase_enum, NULL, NULL, NULL, NULL);

/* Spec: ENUM is available in the active state too. A host that restarted while the ECP
 * kept running enumerates again, and the channels are left as they are.
 */
ZTEST(ecp_active, test_enum_again_while_active)
{
	struct ecp_request_enum q = {.ecp_type = ECP_TEST_ENUM_TYPE, .ecp_revision = 2};

	ecp_test_expect(ECP_CMD_ENUM, 1, &q, sizeof(q), ECP_RES_SUCCESS, &resp);

	/* Still active, with the same port */
	zassert_true(device_is_ready(ECP_TEST_PORT));
	zassert_equal(port_channel_count(PORT_1), ECP_TEST_NUM_CHANNELS);
	zassert_equal(port_fake_set_value_fake.call_count, 0, "Outputs changed");
	zassert_equal(port_fake_pause_fake.call_count, 0, "Channel paused");
	zassert_equal(port_fake_resume_fake.call_count, 0, "Channel resumed");
}

/* The port set up by the first ENUM can't change */
ZTEST(ecp_active, test_enum_other_type_while_active)
{
	struct ecp_request_enum q = {
		.ecp_type = (ECP_TEST_ENUM_TYPE == ECP_TYPE_DO_DI_5A) ? ECP_TYPE_DO_DI_13A
								       : ECP_TYPE_DO_DI_5A,
		.ecp_revision = 2,
	};
	struct ecp_request_io_read r = {.ch = PORT_CH_A};

	ecp_test_expect(ECP_CMD_ENUM, 1, &q, sizeof(q), ECP_RES_INVALID_PARAM, &resp);

	/* Still active */
	ecp_test_expect(ECP_CMD_IO_READ, 2, &r, sizeof(r), ECP_RES_SUCCESS, &resp);
}

ZTEST_SUITE(ecp_active, ecp_phase_active, NULL, NULL, NULL, NULL);
```

## src/test_estop.c
```c
/*
 * ESTOP in the active state, and recovering by enumerating again. Runs last, because ESTOP
 * returns the ECP to the unconfigured state. The tests run in order, and each depends on
 * the ones before it.
 */
#include <zephyr/ztest.h>

#include <dp/drivers/port.h>
#include <dp/drivers/port_fake.h>

#include "ecp_test.h"

static struct ecp_sim_response resp;

/* Channel B is paused before ESTOP, so it stays paused after enumerating again */
static bool paused[ECP_TEST_NUM_CHANNELS] = {[PORT_CH_B] = true};
static int sensor_power[ECP_TEST_NUM_CHANNELS] = {[PORT_CH_A] = 1, [PORT_CH_B] = 2};

static int is_paused(const struct device *dev, enum port_channel_id ch)
{
	return paused[ch] ? 1 : 0;
}

static int pause(const struct device *dev, enum port_channel_id ch)
{
	paused[ch] = true;
	return 0;
}

/* Whether the channel's output was set to off before it was resumed */
static bool off_before_resume[ECP_TEST_NUM_CHANNELS];

static int resume(const struct device *dev, enum port_channel_id ch)
{
	unsigned int n = MIN(port_fake_set_value_fake.call_count, FFF_ARG_HISTORY_LEN);

	for (unsigned int i = 0; i < n; i++) {
		if (port_fake_set_value_fake.arg1_history[i] == ch &&
		    port_fake_set_value_fake.arg2_history[i] == 0) {
			off_before_resume[ch] = true;
		}
	}
	paused[ch] = false;
	return 0;
}

static int get_sensor_power(const struct device *dev, enum port_channel_id ch, int *value)
{
	*value = sensor_power[ch];
	return 0;
}

static int set_sensor_power(const struct device *dev, enum port_channel_id ch, int value)
{
	sensor_power[ch] = value;
	return 0;
}

static void estop_before(void *fixture)
{
	ARG_UNUSED(fixture);

	/* Fakes are reset before each test by the fake port driver */
	port_fake_paused_fake.custom_fake = is_paused;
	port_fake_pause_fake.custom_fake = pause;
	port_fake_resume_fake.custom_fake = resume;
	port_fake_get_sensor_power_fake.custom_fake = get_sensor_power;
	port_fake_set_sensor_power_fake.custom_fake = set_sensor_power;
}

static void expect_io(enum ecp_result_code expected)
{
	struct ecp_request_io_read q = {.ch = PORT_CH_A};

	ecp_test_expect(ECP_CMD_IO_READ, 2, &q, sizeof(q), expected, &resp);
}

ZTEST(ecp_estop, test_1_estop_with_data)
{
	const uint8_t data = 0;

	ecp_test_expect(ECP_CMD_ESTOP, 1, &data, sizeof(data), ECP_RES_INVALID_COMMAND, &resp);

	/* Nothing happened */
	zassert_equal(port_fake_pause_fake.call_count, 0);
	expect_io(ECP_RES_SUCCESS);
}

/* Spec: ESTOP returns all I/O to a safe state and enters the unconfigured state */
ZTEST(ecp_estop, test_2_estop)
{
	ecp_test_expect(ECP_CMD_ESTOP, 1, NULL, 0, ECP_RES_IN_PROGRESS, &resp);

	/* The safe state is reached before the response */
	for (int ch = 0; ch < ECP_TEST_NUM_CHANNELS; ch++) {
		zassert_true(paused[ch], "Channel %d not paused", ch);
		zassert_equal(sensor_power[ch], 0, "Channel %d sensor power on", ch);
	}
	ecp_test_expect_in_progress_result(ECP_RES_SUCCESS);

	expect_io(ECP_RES_NOT_ALLOWED);

	/* ESTOP again: still stopped */
	ecp_test_expect(ECP_CMD_ESTOP, 1, NULL, 0, ECP_RES_IN_PROGRESS, &resp);
	ecp_test_expect_in_progress_result(ECP_RES_SUCCESS);
	expect_io(ECP_RES_NOT_ALLOWED);
}

ZTEST(ecp_estop, test_3_enum_other_type)
{
	struct ecp_request_enum q = {
		.ecp_type = (ECP_TEST_ENUM_TYPE == ECP_TYPE_DO_DI_5A) ? ECP_TYPE_DO_DI_13A
								       : ECP_TYPE_DO_DI_5A,
		.ecp_revision = 2,
	};

	ecp_test_expect(ECP_CMD_ENUM, 1, &q, sizeof(q), ECP_RES_INVALID_PARAM, &resp);
	expect_io(ECP_RES_NOT_ALLOWED);
}

/* Enumerating again leaves every output and sensor power off until the host commands them
 * (SRS-352, SRS-354). Channels the host had paused stay paused; the others are resumed,
 * but only after their output is set to off.
 */
ZTEST(ecp_estop, test_4_enum_again)
{
	struct ecp_request_enum q = {.ecp_type = ECP_TEST_ENUM_TYPE, .ecp_revision = 2};

	ecp_test_expect(ECP_CMD_ENUM, 1, &q, sizeof(q), ECP_RES_SUCCESS, &resp);

	zassert_false(paused[PORT_CH_A], "Channel A not resumed");
	zassert_true(off_before_resume[PORT_CH_A], "Channel A resumed before its output was off");
	zassert_true(paused[PORT_CH_B], "Channel B was paused before ESTOP, but was resumed");
	zassert_equal(sensor_power[PORT_CH_A], 0, "Channel A sensor power back on");
	zassert_equal(sensor_power[PORT_CH_B], 0, "Channel B sensor power back on");

	expect_io(ECP_RES_SUCCESS);

	/* Active again, and ENUM is still accepted */
	ecp_test_expect(ECP_CMD_ENUM, 1, &q, sizeof(q), ECP_RES_SUCCESS, &resp);
}

ZTEST_SUITE(ecp_estop, ecp_phase_estop, NULL, estop_before, NULL, NULL);
```

## src/test_gpio.c
```c
/*
 * GPIO_CONFIG and GPIO. The ECP exposes 6 virtual pins (the RGB LEDs for channels A and
 * B), mapped to gpio0 pins 0-5 on native_sim. The LEDs are active low.
 */
#include <zephyr/ztest.h>
#include <zephyr/drivers/gpio/gpio_emul.h>
#include <zephyr/sys/byteorder.h>

#include "ecp_test.h"

#define GPIO_DEV       DEVICE_DT_GET(DT_NODELABEL(gpio0))
#define NUM_PINS       6
#define SUPPORTED_PINS BIT_MASK(NUM_PINS)

static struct ecp_sim_response resp;

/* Returns the direction bits: 0 for output, 1 for input */
static uint16_t gpio_config(uint16_t direction, uint16_t mask)
{
	struct ecp_request_gpio_config q = {.direction = direction, .mask = mask};

	ecp_test_expect(ECP_CMD_GPIO_CONFIG, 1, &q, sizeof(q), ECP_RES_SUCCESS, &resp);
	zassert_equal(resp.data_len, sizeof(struct ecp_response_gpio_config));
	return sys_get_le16(resp.data);
}

/* Returns the input bits */
static uint16_t gpio(uint16_t outputs, uint16_t mask)
{
	struct ecp_request_gpio q = {.outputs = outputs, .mask = mask};

	ecp_test_expect(ECP_CMD_GPIO, 1, &q, sizeof(q), ECP_RES_SUCCESS, &resp);
	zassert_equal(resp.data_len, sizeof(struct ecp_response_gpio));
	return sys_get_le16(resp.data);
}

static void gpio_before(void *fixture)
{
	ARG_UNUSED(fixture);

	/* All supported pins are outputs, and off */
	gpio_config(0, SUPPORTED_PINS);
	gpio(0, SUPPORTED_PINS);
}

ZTEST(ecp_gpio, test_gpio_config)
{
	/* Unsupported pins always read as inputs */
	zassert_equal(gpio_config(0, 0), (uint16_t)~SUPPORTED_PINS);

	zassert_equal(gpio_config(BIT(0) | BIT(4), BIT(0) | BIT(4)),
		      (uint16_t)~SUPPORTED_PINS | BIT(0) | BIT(4));

	/* Bits outside the mask aren't changed */
	zassert_equal(gpio_config(0xFFFF, BIT(1)),
		      (uint16_t)~SUPPORTED_PINS | BIT(0) | BIT(1) | BIT(4));
	zassert_equal(gpio_config(0, BIT(0)), (uint16_t)~SUPPORTED_PINS | BIT(1) | BIT(4));
}

ZTEST(ecp_gpio, test_gpio_config_unsupported_pins_ignored)
{
	zassert_equal(gpio_config(0, 0xFFFF), (uint16_t)~SUPPORTED_PINS);
	zassert_equal(gpio_config(0xFFFF, (uint16_t)~SUPPORTED_PINS), (uint16_t)~SUPPORTED_PINS);
}

ZTEST(ecp_gpio, test_gpio_outputs)
{
	for (int pin = 0; pin < NUM_PINS; pin++) {
		gpio(BIT(pin), BIT(pin));
		/* Active low */
		zassert_equal(gpio_emul_output_get(GPIO_DEV, pin), 0, "Pin %d not on", pin);

		gpio(0, BIT(pin));
		zassert_equal(gpio_emul_output_get(GPIO_DEV, pin), 1, "Pin %d not off", pin);
	}

	/* Bits outside the mask aren't changed */
	gpio(BIT(1), BIT(1));
	gpio(BIT(2), BIT(2));
	zassert_equal(gpio_emul_output_get(GPIO_DEV, 1), 0);
	zassert_equal(gpio_emul_output_get(GPIO_DEV, 2), 0);
}

ZTEST(ecp_gpio, test_gpio_inputs)
{
	gpio_config(BIT(3), BIT(3));

	/* Active low */
	zassert_ok(gpio_emul_input_set(GPIO_DEV, 3, 0));
	zassert_equal(gpio(0, 0), BIT(3));

	zassert_ok(gpio_emul_input_set(GPIO_DEV, 3, 1));
	zassert_equal(gpio(0, 0), 0);

	/* Spec: attempts to set inputs are ignored */
	zassert_equal(gpio(BIT(3), BIT(3)), 0);
	zassert_equal(gpio_config(0, 0), (uint16_t)~SUPPORTED_PINS | BIT(3), "Pin became an output");
}

ZTEST_SUITE(ecp_gpio, ecp_phase_any, NULL, gpio_before, NULL, NULL);
```

## src/test_inactivity.c
```c
/*
 * Host inactivity timeout (SRS-354): with no valid request for
 * CONFIG_APP_ECP_HOST_TIMEOUT_MS, the ECP switches off every output and sensor power. They
 * stay off until the host commands them again.
 */
#include <zephyr/ztest.h>

#include <dp/drivers/port.h>
#include <dp/drivers/port_fake.h>

#include "ecp_test.h"

#define TIMEOUT_MS CONFIG_APP_ECP_HOST_TIMEOUT_MS

static struct ecp_sim_response resp;
static uint8_t frame[CONFIG_ECP_DEVICE_CMD_HANDLER_RX_BUFFER_SIZE];

static void io_write(enum port_channel_id ch, int32_t value)
{
	struct ecp_request_io_write q = {.ch = ch, .value = value};

	ecp_test_expect(ECP_CMD_IO_WRITE, 1, &q, sizeof(q), ECP_RES_SUCCESS, &resp);
}

static void io_read_all(void)
{
	ecp_test_expect(ECP_CMD_IO_READ, 3, NULL, 0, ECP_RES_SUCCESS, &resp);
}

/* How many times the channel's output was set to @a value */
static int writes_of(enum port_channel_id ch, int value)
{
	unsigned int n = MIN(port_fake_set_value_fake.call_count, FFF_ARG_HISTORY_LEN);
	int count = 0;

	for (unsigned int i = 0; i < n; i++) {
		if (port_fake_set_value_fake.arg1_history[i] == ch &&
		    port_fake_set_value_fake.arg2_history[i] == value) {
			count++;
		}
	}
	return count;
}

/* How many times the channel's sensor power was switched off */
static int sensor_power_offs(enum port_channel_id ch)
{
	unsigned int n = MIN(port_fake_set_sensor_power_fake.call_count, FFF_ARG_HISTORY_LEN);
	int count = 0;

	for (unsigned int i = 0; i < n; i++) {
		if (port_fake_set_sensor_power_fake.arg1_history[i] == ch &&
		    port_fake_set_sensor_power_fake.arg2_history[i] == 0) {
			count++;
		}
	}
	return count;
}

static void assert_outputs_switched_off(int times)
{
	for (enum port_channel_id ch = PORT_CH_A; ch < ECP_TEST_NUM_CHANNELS; ch++) {
		zassert_equal(writes_of(ch, 0), times, "Channel %d output off %d times, not %d",
			      ch, writes_of(ch, 0), times);
		zassert_equal(sensor_power_offs(ch), times,
			      "Channel %d sensor power off %d times, not %d", ch,
			      sensor_power_offs(ch), times);
	}
}

/* A host that keeps talking keeps the outputs as commanded */
ZTEST(ecp_inactivity, test_requests_keep_outputs)
{
	io_write(PORT_CH_A, 500);

	for (int i = 0; i < 6; i++) {
		k_msleep(TIMEOUT_MS / 2);
		io_read_all();
	}

	assert_outputs_switched_off(0);
	zassert_equal(port_fake_set_value_fake.call_count, 1);
}

/* Silence switches every output and sensor power off, once */
ZTEST(ecp_inactivity, test_silence_switches_outputs_off)
{
	io_write(PORT_CH_A, 500);
	io_write(PORT_CH_B, 300);

	k_msleep(TIMEOUT_MS - 10);
	assert_outputs_switched_off(0);

	k_msleep(20);
	assert_outputs_switched_off(1);

	/* They stay off, without being switched off again */
	k_msleep(3 * TIMEOUT_MS);
	assert_outputs_switched_off(1);
}

/* After the timeout, the host's next command applies as usual */
ZTEST(ecp_inactivity, test_command_after_timeout_applies)
{
	io_write(PORT_CH_A, 500);
	k_msleep(TIMEOUT_MS + 10);
	assert_outputs_switched_off(1);

	io_write(PORT_CH_A, 700);
	zassert_equal(port_fake_set_value_fake.arg1_val, PORT_CH_A);
	zassert_equal(port_fake_set_value_fake.arg2_val, 700);

	k_msleep(TIMEOUT_MS / 2);
	io_read_all();
	k_msleep(TIMEOUT_MS / 2);
	assert_outputs_switched_off(1);
}

/* Corrupted frames aren't valid requests, so they don't keep the outputs on */
ZTEST(ecp_inactivity, test_corrupted_frames_dont_count)
{
	io_write(PORT_CH_A, 500);

	for (int i = 0; i < 3; i++) {
		k_msleep(TIMEOUT_MS / 2);

		size_t len = ecp_sim_host_build_request(frame, sizeof(frame), ECP_CMD_IO_READ, 3,
							 0, false, NULL, 0);
		struct ecp_request_header *header = (void *)frame;

		header->header_crc ^= 0xFF;
		ecp_sim_host_send_raw(frame, len, &resp);
		zassert_equal(resp.result, ECP_RES_INVALID_HEADER_CRC);
	}

	assert_outputs_switched_off(1);
}

ZTEST_SUITE(ecp_inactivity, ecp_phase_active, NULL, NULL, NULL, NULL);
```

## src/test_io.c
```c
/*
 * IO commands, which are only available in the active state
 */
#include <limits.h>
#include <string.h>

#include <zephyr/ztest.h>

#include <dp/drivers/port.h>
#include <dp/drivers/port_fake.h>

#include "ecp_test.h"

static struct ecp_sim_response resp;

/* Channel-specific values returned by the fake port */
#define MODE(ch)        (3 + (ch))
#define RAW(ch)         (1000 + (ch))
#define SCALED(ch)      (-2000 - (ch))
#define VOLTAGE(ch)     (12000 + (ch))
#define CURRENT(ch)     (500 + (ch))
#define TEMPERATURE(ch) (25000 + (ch))
#define FAULT(ch)       ((ch) == PORT_CH_A ? PORT_CH_OK : PORT_CH_FAULT_TEMPERATURE)
#define STATUS(ch)      ((ch) == PORT_CH_A ? PORT_CH_STATUS_ACTIVE : PORT_CH_STATUS_ERROR)
#define SPWR(ch)        ((ch) == PORT_CH_A ? 1 : 0)
#define SOFT_SWITCH(ch) ((ch) == PORT_CH_A ? 0 : 2)

static bool paused[ECP_TEST_NUM_CHANNELS];

static int get_attribute(const struct device *dev, enum port_channel_id ch,
			 enum port_channel_attribute_id attr, uintptr_t *value)
{
	*value = (attr == PORT_CH_ATTRIB_MODE) ? MODE(ch) : 0;
	return 0;
}

#define DEFINE_GETTER(_name, _type, _value)                                                        \
	static int _name(const struct device *dev, enum port_channel_id ch, _type *value)          \
	{                                                                                          \
		*value = _value;                                                                   \
		return 0;                                                                          \
	}

DEFINE_GETTER(get_raw_value, int, RAW(ch))
DEFINE_GETTER(get_value, int, SCALED(ch))
DEFINE_GETTER(get_analog_value, int, VOLTAGE(ch))
DEFINE_GETTER(get_current, int, CURRENT(ch))
DEFINE_GETTER(get_temperature, int, TEMPERATURE(ch))
DEFINE_GETTER(get_fault_status, enum port_channel_fault_status, FAULT(ch))
DEFINE_GETTER(get_status, enum port_channel_status, STATUS(ch))
DEFINE_GETTER(get_sensor_power, int, SPWR(ch))
DEFINE_GETTER(get_soft_switch_status, int, SOFT_SWITCH(ch))

static int pause(const struct device *dev, enum port_channel_id ch)
{
	paused[ch] = true;
	return 0;
}

static int resume(const struct device *dev, enum port_channel_id ch)
{
	paused[ch] = false;
	return 0;
}

static int is_paused(const struct device *dev, enum port_channel_id ch)
{
	return paused[ch] ? 1 : 0;
}

static void io_before(void *fixture)
{
	ARG_UNUSED(fixture);

	/* Fakes are reset before each test by the fake port driver */
	port_fake_get_attribute_fake.custom_fake = get_attribute;
	port_fake_get_raw_value_fake.custom_fake = get_raw_value;
	port_fake_get_value_fake.custom_fake = get_value;
	port_fake_get_analog_value_fake.custom_fake = get_analog_value;
	port_fake_get_current_fake.custom_fake = get_current;
	port_fake_get_temperature_fake.custom_fake = get_temperature;
	port_fake_get_fault_status_fake.custom_fake = get_fault_status;
	port_fake_get_status_fake.custom_fake = get_status;
	port_fake_get_sensor_power_fake.custom_fake = get_sensor_power;
	port_fake_get_soft_switch_status_fake.custom_fake = get_soft_switch_status;
	port_fake_pause_fake.custom_fake = pause;
	port_fake_resume_fake.custom_fake = resume;
	port_fake_paused_fake.custom_fake = is_paused;

	memset(paused, 0, sizeof(paused));
}

static void check_io_read(const uint8_t *data, enum port_channel_id ch)
{
	struct ecp_response_io_read r;
	memcpy(&r, data, sizeof(r));

	zassert_equal(r.ch, ch);
	zassert_equal(r.mode, MODE(ch));
	zassert_equal(r.raw, RAW(ch));
	zassert_equal((int32_t)r.scaled, SCALED(ch));
	zassert_equal(r.voltage, VOLTAGE(ch));
	zassert_equal(r.current, CURRENT(ch));
	zassert_equal(r.temperature, TEMPERATURE(ch));
	zassert_equal(r.fault_status, FAULT(ch));
	zassert_equal(r.hb_direction, PORT_HBRIDGE_DIR_INVALID);
	zassert_equal(FIELD_GET(ECP_IO_F_CH_STATUS_MASK, r.flags), STATUS(ch));
	zassert_equal(FIELD_GET(ECP_IO_F_SPWR_STATUS_MASK, r.flags), SPWR(ch));
	zassert_equal(FIELD_GET(ECP_IO_F_SOFT_SWITCH_STATUS_MASK, r.flags), SOFT_SWITCH(ch));
	zassert_equal(FIELD_GET(ECP_IO_F_PAUSED, r.flags), paused[ch]);
	zassert_equal(r.flags & BIT(0), 0, "Reserved flag set");
}

ZTEST(ecp_io, test_io_read)
{
	paused[PORT_CH_B] = true;

	for (enum port_channel_id ch = PORT_CH_A; ch < ECP_TEST_NUM_CHANNELS; ch++) {
		struct ecp_request_io_read q = {.ch = ch};

		ecp_test_expect(ECP_CMD_IO_READ, 2, &q, sizeof(q), ECP_RES_SUCCESS, &resp);
		zassert_equal(resp.data_len, sizeof(struct ecp_response_io_read));
		check_io_read(resp.data, ch);
		zassert_equal(port_fake_get_value_fake.arg0_val, ECP_TEST_PORT);
	}
}

ZTEST(ecp_io, test_io_read_all_channels)
{
	paused[PORT_CH_A] = true;

	ecp_test_expect(ECP_CMD_IO_READ, 3, NULL, 0, ECP_RES_SUCCESS, &resp);
	zassert_equal(resp.data_len, 1 + ECP_TEST_NUM_CHANNELS * sizeof(struct ecp_response_io_read));
	zassert_equal(resp.data[0], ECP_TEST_NUM_CHANNELS);

	for (enum port_channel_id ch = PORT_CH_A; ch < ECP_TEST_NUM_CHANNELS; ch++) {
		check_io_read(&resp.data[1 + ch * sizeof(struct ecp_response_io_read)], ch);
	}
}

ZTEST(ecp_io, test_io_read_invalid_request)
{
	struct ecp_request_io_read q = {.ch = PORT_CH_A};
	uint8_t two[2] = {0};

	ecp_test_expect(ECP_CMD_IO_READ, 2, NULL, 0, ECP_RES_INVALID_PARAM, &resp);
	ecp_test_expect(ECP_CMD_IO_READ, 2, two, sizeof(two), ECP_RES_INVALID_PARAM, &resp);
	ecp_test_expect(ECP_CMD_IO_READ, 3, &q, sizeof(q), ECP_RES_INVALID_PARAM, &resp);
	ecp_test_expect(ECP_CMD_IO_READ, 1, &q, sizeof(q), ECP_RES_UNSUPPORTED_CMD_VERSION, &resp);
}

ZTEST(ecp_io, test_io_read_mode_error)
{
	struct ecp_request_io_read q = {.ch = PORT_CH_A};

	port_fake_get_attribute_fake.custom_fake = NULL;
	port_fake_get_attribute_fake.return_val = -EIO;

	ecp_test_expect(ECP_CMD_IO_READ, 2, &q, sizeof(q), ECP_RES_ERROR, &resp);
	ecp_test_expect(ECP_CMD_IO_READ, 3, NULL, 0, ECP_RES_ERROR, &resp);
}

/* A port that only reports its mode */
static void only_mode_supported(void)
{
	port_fake_reset();
	port_fake_get_attribute_fake.custom_fake = get_attribute;
	port_fake_get_raw_value_fake.return_val = -ENOTSUP;
	port_fake_get_value_fake.return_val = -ENOTSUP;
	port_fake_get_analog_value_fake.return_val = -ENOTSUP;
	port_fake_get_current_fake.return_val = -ENOTSUP;
	port_fake_get_temperature_fake.return_val = -ENOTSUP;
	port_fake_get_fault_status_fake.return_val = -ENOTSUP;
	port_fake_get_status_fake.return_val = -ENOTSUP;
	port_fake_get_sensor_power_fake.return_val = -ENOTSUP;
	port_fake_get_soft_switch_status_fake.return_val = -ENOTSUP;
	port_fake_paused_fake.return_val = -ENOTSUP;
}

ZTEST(ecp_io, test_io_read_unsupported_status)
{
	struct ecp_request_io_read q = {.ch = PORT_CH_A};

	only_mode_supported();
	ecp_test_expect(ECP_CMD_IO_READ, 2, &q, sizeof(q), ECP_RES_SUCCESS, &resp);

	struct ecp_response_io_read r;
	memcpy(&r, resp.data, sizeof(r));
	zassert_equal(r.mode, MODE(PORT_CH_A));
	zassert_equal(FIELD_GET(ECP_IO_F_CH_STATUS_MASK, r.flags), 3, "Not 'not available'");
	zassert_equal(FIELD_GET(ECP_IO_F_SPWR_STATUS_MASK, r.flags), 3, "Not 'not available'");
	zassert_equal(FIELD_GET(ECP_IO_F_SOFT_SWITCH_STATUS_MASK, r.flags), 3,
		      "Not 'not available'");
	zassert_equal(FIELD_GET(ECP_IO_F_PAUSED, r.flags), 0);
}

/* Spec: values the port can't provide are -1 */
ZTEST(ecp_io, test_io_read_unsupported_values)
{
	struct ecp_request_io_read q = {.ch = PORT_CH_A};

	only_mode_supported();
	ecp_test_expect(ECP_CMD_IO_READ, 2, &q, sizeof(q), ECP_RES_SUCCESS, &resp);

	struct ecp_response_io_read r;
	memcpy(&r, resp.data, sizeof(r));
	zassert_equal(r.raw, UINT32_MAX);
	zassert_equal((int32_t)r.scaled, -1);
	zassert_equal(r.voltage, -1);
	zassert_equal(r.current, -1);
	zassert_equal(r.temperature, -1);
}

ZTEST(ecp_io, test_io_write)
{
	struct ecp_request_io_write q = {.ch = PORT_CH_B, .value = -12345};

	ecp_test_expect(ECP_CMD_IO_WRITE, 1, &q, sizeof(q), ECP_RES_SUCCESS, &resp);
	zassert_equal(port_fake_set_value_fake.call_count, 1);
	zassert_equal(port_fake_set_value_fake.arg0_val, ECP_TEST_PORT);
	zassert_equal(port_fake_set_value_fake.arg1_val, PORT_CH_B);
	zassert_equal(port_fake_set_value_fake.arg2_val, -12345);

	port_fake_set_value_fake.return_val = -EINVAL;
	ecp_test_expect(ECP_CMD_IO_WRITE, 1, &q, sizeof(q), ECP_RES_ERROR, &resp);

	ecp_test_expect(ECP_CMD_IO_WRITE, 1, &q, sizeof(q) - 1, ECP_RES_INVALID_PARAM, &resp);
}

ZTEST(ecp_io, test_io_get_attrib)
{
	struct ecp_request_io_get_attrib q = {.ch = PORT_CH_B, .attrib_id = PORT_CH_ATTRIB_MODE};

	ecp_test_expect(ECP_CMD_IO_GET_ATTRIB, 1, &q, sizeof(q), ECP_RES_SUCCESS, &resp);
	zassert_equal(resp.data_len, sizeof(struct ecp_response_io_get_attrib));
	zassert_equal(port_fake_get_attribute_fake.arg0_val, ECP_TEST_PORT);
	zassert_equal(port_fake_get_attribute_fake.arg1_val, PORT_CH_B);
	zassert_equal(port_fake_get_attribute_fake.arg2_val, PORT_CH_ATTRIB_MODE);

	struct ecp_response_io_get_attrib r;
	memcpy(&r, resp.data, sizeof(r));
	zassert_equal(r.ch, PORT_CH_B);
	zassert_equal(r.attrib_id, PORT_CH_ATTRIB_MODE);
	zassert_equal(r.value, MODE(PORT_CH_B));

	port_fake_get_attribute_fake.custom_fake = NULL;
	port_fake_get_attribute_fake.return_val = -ENOTSUP;
	ecp_test_expect(ECP_CMD_IO_GET_ATTRIB, 1, &q, sizeof(q), ECP_RES_NOT_SUPPORTED, &resp);

	port_fake_get_attribute_fake.return_val = -EIO;
	ecp_test_expect(ECP_CMD_IO_GET_ATTRIB, 1, &q, sizeof(q), ECP_RES_ERROR, &resp);
}

ZTEST(ecp_io, test_io_set_attrib)
{
	struct ecp_request_io_set_attrib q = {
		.ch = PORT_CH_A,
		.attrib_id = PORT_CH_ATTRIB_PWM_FREQ,
		.value = 0xDEADBEEF,
	};

	ecp_test_expect(ECP_CMD_IO_SET_ATTRIB, 1, &q, sizeof(q), ECP_RES_SUCCESS, &resp);
	zassert_equal(port_fake_set_attribute_fake.arg0_val, ECP_TEST_PORT);
	zassert_equal(port_fake_set_attribute_fake.arg1_val, PORT_CH_A);
	zassert_equal(port_fake_set_attribute_fake.arg2_val, PORT_CH_ATTRIB_PWM_FREQ);
	zassert_equal(port_fake_set_attribute_fake.arg3_val, 0xDEADBEEF);

	port_fake_set_attribute_fake.return_val = -ENOTSUP;
	ecp_test_expect(ECP_CMD_IO_SET_ATTRIB, 1, &q, sizeof(q), ECP_RES_NOT_SUPPORTED, &resp);

	port_fake_set_attribute_fake.return_val = -EINVAL;
	ecp_test_expect(ECP_CMD_IO_SET_ATTRIB, 1, &q, sizeof(q), ECP_RES_ERROR, &resp);
}

static void io_pause(uint8_t pause_mask, uint8_t ch_mask, uint8_t expected_paused)
{
	struct ecp_request_io_pause q = {.pause = pause_mask, .ch_mask = ch_mask};

	ecp_test_expect(ECP_CMD_IO_PAUSE, 1, &q, sizeof(q), ECP_RES_SUCCESS, &resp);
	zassert_equal(resp.data_len, sizeof(struct ecp_response_io_pause));
	zassert_equal(resp.data[0], expected_paused, "pause=0x%02x ch_mask=0x%02x: paused=0x%02x",
		      pause_mask, ch_mask, resp.data[0]);
}

ZTEST(ecp_io, test_io_pause)
{
	io_pause(BIT(PORT_CH_A), BIT(PORT_CH_A), BIT(PORT_CH_A));
	zassert_equal(port_fake_pause_fake.arg1_val, PORT_CH_A);

	/* B is paused, and A is left alone */
	io_pause(BIT(PORT_CH_B), BIT(PORT_CH_B), BIT(PORT_CH_A) | BIT(PORT_CH_B));

	/* Resume A only */
	io_pause(0, BIT(PORT_CH_A), BIT(PORT_CH_B));

	/* Pause A and resume B together */
	io_pause(BIT(PORT_CH_A), BIT(PORT_CH_A) | BIT(PORT_CH_B), BIT(PORT_CH_A));

	/* An empty mask just reports the state */
	io_pause(0xFF, 0, BIT(PORT_CH_A));
}

ZTEST(ecp_io, test_io_pause_error)
{
	struct ecp_request_io_pause q = {.pause = BIT(PORT_CH_A), .ch_mask = BIT(PORT_CH_A)};

	port_fake_pause_fake.custom_fake = NULL;
	port_fake_pause_fake.return_val = -EIO;

	enum ecp_result_code result =
		ecp_sim_host_transact(ECP_CMD_IO_PAUSE, 1, &q, sizeof(q), &resp);
	zassert_not_equal(result, ECP_RES_SUCCESS);
}

ZTEST(ecp_io, test_io_clear_fault)
{
	struct ecp_request_io_clear_fault q = {.ch = PORT_CH_B};

	ecp_test_expect(ECP_CMD_IO_CLEAR_FAULT, 1, &q, sizeof(q), ECP_RES_SUCCESS, &resp);
	zassert_equal(port_fake_clear_fault_fake.call_count, 1);
	zassert_equal(port_fake_clear_fault_fake.arg0_val, ECP_TEST_PORT);
	zassert_equal(port_fake_clear_fault_fake.arg1_val, PORT_CH_B);

	port_fake_clear_fault_fake.return_val = -EIO;
	ecp_test_expect(ECP_CMD_IO_CLEAR_FAULT, 1, &q, sizeof(q), ECP_RES_ERROR, &resp);
}

/* Spec: INVALID_PARAM for out of range parameters. The channel should be checked before
 * it reaches the port driver.
 */
ZTEST(ecp_io, test_io_channel_out_of_range)
{
	const uint8_t ch = ECP_TEST_NUM_CHANNELS;
	struct ecp_request_io_read read_q = {.ch = ch};
	struct ecp_request_io_write write_q = {.ch = ch};
	struct ecp_request_io_get_attrib get_q = {.ch = ch};
	struct ecp_request_io_set_attrib set_q = {.ch = ch};
	struct ecp_request_io_pause pause_q = {.pause = BIT(ch), .ch_mask = BIT(ch)};
	struct ecp_request_io_clear_fault clear_q = {.ch = ch};

	ecp_test_expect(ECP_CMD_IO_READ, 2, &read_q, sizeof(read_q), ECP_RES_INVALID_PARAM, &resp);
	ecp_test_expect(ECP_CMD_IO_WRITE, 1, &write_q, sizeof(write_q), ECP_RES_INVALID_PARAM,
			&resp);
	ecp_test_expect(ECP_CMD_IO_GET_ATTRIB, 1, &get_q, sizeof(get_q), ECP_RES_INVALID_PARAM,
			&resp);
	ecp_test_expect(ECP_CMD_IO_SET_ATTRIB, 1, &set_q, sizeof(set_q), ECP_RES_INVALID_PARAM,
			&resp);
	ecp_test_expect(ECP_CMD_IO_PAUSE, 1, &pause_q, sizeof(pause_q), ECP_RES_INVALID_PARAM,
			&resp);
	ecp_test_expect(ECP_CMD_IO_CLEAR_FAULT, 1, &clear_q, sizeof(clear_q),
			ECP_RES_INVALID_PARAM, &resp);

	/* Nothing reached the port driver */
	zassert_equal(port_fake_get_attribute_fake.call_count, 0);
	zassert_equal(port_fake_set_value_fake.call_count, 0);
	zassert_equal(port_fake_set_attribute_fake.call_count, 0);
	zassert_equal(port_fake_pause_fake.call_count, 0);
	zassert_equal(port_fake_resume_fake.call_count, 0);
	zassert_equal(port_fake_clear_fault_fake.call_count, 0);
}

/* An invalid channel in the mask means no channel is paused or resumed */
ZTEST(ecp_io, test_io_pause_partly_out_of_range)
{
	struct ecp_request_io_pause q = {
		.pause = BIT(PORT_CH_A),
		.ch_mask = BIT(PORT_CH_A) | BIT(ECP_TEST_NUM_CHANNELS),
	};

	ecp_test_expect(ECP_CMD_IO_PAUSE, 1, &q, sizeof(q), ECP_RES_INVALID_PARAM, &resp);
	zassert_equal(port_fake_pause_fake.call_count, 0);
	zassert_false(paused[PORT_CH_A]);
}

ZTEST_SUITE(ecp_io, ecp_phase_active, NULL, io_before, NULL, NULL);
```

## src/test_led.c
```c
/*
 * LED_COLOR and LED_BRIGHTNESS. The application doesn't map any LEDs yet, so every
 * LED index is out of range.
 */
#include <zephyr/ztest.h>

#include "ecp_test.h"

static struct ecp_sim_response resp;

ZTEST(ecp_led, test_led_color_no_leds)
{
	const uint8_t q[] = {0, 3, 0x10, 0x20, 0x30};

	ecp_test_expect(ECP_CMD_LED_COLOR, 1, q, sizeof(q), ECP_RES_INVALID_PARAM, &resp);
}

ZTEST(ecp_led, test_led_color_length_mismatch)
{
	/* 3 colors, but 2 provided */
	const uint8_t q[] = {0, 3, 0x10, 0x20};

	ecp_test_expect(ECP_CMD_LED_COLOR, 1, q, sizeof(q), ECP_RES_INVALID_COMMAND, &resp);
}

ZTEST(ecp_led, test_led_brightness_no_leds)
{
	struct ecp_request_led_brightness q = {.led = 0, .brightness = 128};

	ecp_test_expect(ECP_CMD_LED_BRIGHTNESS, 1, &q, sizeof(q), ECP_RES_INVALID_PARAM, &resp);

	/* All LEDs: there are none, so nothing to fail */
	q.led = 0xFF;
	ecp_test_expect(ECP_CMD_LED_BRIGHTNESS, 1, &q, sizeof(q), ECP_RES_SUCCESS, &resp);
}

ZTEST_SUITE(ecp_led, ecp_phase_active, NULL, NULL, NULL, NULL);
```

## src/test_peek_poke.c
```c
/*
 * PEEK and POKE, against buffers in the test. On native_sim, every address is allowed.
 */
#include <string.h>

#include <zephyr/ztest.h>

#include "ecp_test.h"

static struct ecp_sim_response resp;

/* Aligned, so 2 and 4 byte POKEs are aligned accesses as the target requires */
static uint8_t target[ECP_MAX_PAYLOAD_BYTES + 1] __aligned(4);

static uint32_t address_of(const void *p)
{
	return (uint32_t)(uintptr_t)p;
}

static void peek_poke_before(void *fixture)
{
	ARG_UNUSED(fixture);

	for (size_t i = 0; i < sizeof(target); i++) {
		target[i] = i * 3;
	}
}

static enum ecp_result_code peek(const void *address, uint16_t count)
{
	struct ecp_request_peek q = {.address = address_of(address), .count = count};

	return ecp_sim_host_transact(ECP_CMD_PEEK, 1, &q, sizeof(q), &resp);
}

static enum ecp_result_code poke(void *address, const void *data, uint16_t count)
{
	static uint8_t q_buf[sizeof(struct ecp_request_poke) + ECP_MAX_PAYLOAD_BYTES];
	struct ecp_request_poke *q = (void *)q_buf;

	q->address = address_of(address);
	q->count = count;
	memcpy(q->data, data, count);

	return ecp_sim_host_transact(ECP_CMD_POKE, 1, q, sizeof(*q) + count, &resp);
}

ZTEST(ecp_peek_poke, test_peek)
{
	const uint16_t counts[] = {1, 2, 3, 4, 100, ecp_sim_host_max_response_data()};

	ARRAY_FOR_EACH(counts, i) {
		zassert_equal(peek(&target[1], counts[i]), ECP_RES_SUCCESS, "count %u", counts[i]);
		zassert_equal(resp.data_len, counts[i]);
		zassert_mem_equal(resp.data, &target[1], counts[i], "count %u", counts[i]);
	}
}

ZTEST(ecp_peek_poke, test_peek_invalid)
{
	zassert_equal(peek(target, 0), ECP_RES_INVALID_PARAM);
	zassert_equal(peek(target, ecp_sim_host_max_response_data() + 1), ECP_RES_INVALID_PARAM);

	/* One byte short, and one byte extra */
	uint8_t q_buf[sizeof(struct ecp_request_peek) + 1] = {0};
	struct ecp_request_peek *q = (void *)q_buf;

	q->address = address_of(target);
	q->count = 1;
	ecp_test_expect(ECP_CMD_PEEK, 1, q, sizeof(*q) - 1, ECP_RES_INVALID_PARAM, &resp);
	ecp_test_expect(ECP_CMD_PEEK, 1, q, sizeof(*q) + 1, ECP_RES_INVALID_PARAM, &resp);
}

ZTEST(ecp_peek_poke, test_poke)
{
	/* 1, 2 and 4 bytes are written as a single access; others with memcpy */
	const uint16_t counts[] = {1, 2, 3, 4, 5, 100};
	uint8_t data[100];

	ARRAY_FOR_EACH(counts, i) {
		uint8_t expected[sizeof(target)];

		for (int j = 0; j < counts[i]; j++) {
			data[j] = 0xF0 ^ (i + j);
		}
		memcpy(expected, target, sizeof(target));
		memcpy(&expected[4], data, counts[i]);

		zassert_equal(poke(&target[4], data, counts[i]), ECP_RES_SUCCESS, "count %u",
			      counts[i]);
		zassert_equal(resp.data_len, 0);
		/* Written, and nothing else touched */
		zassert_mem_equal(target, expected, sizeof(target), "count %u", counts[i]);
	}
}

ZTEST(ecp_peek_poke, test_poke_invalid)
{
	static uint8_t q_buf[sizeof(struct ecp_request_poke) + 4];
	struct ecp_request_poke *q = (void *)q_buf;
	uint8_t data = 0xAA;
	uint8_t before[sizeof(target)];

	memcpy(before, target, sizeof(target));

	zassert_equal(poke(target, &data, 0), ECP_RES_INVALID_PARAM);

	/* count doesn't match the data length */
	q->address = address_of(target);
	q->count = 4;
	ecp_test_expect(ECP_CMD_POKE, 1, q, sizeof(*q) + 3, ECP_RES_INVALID_PARAM, &resp);
	q->count = 2;
	ecp_test_expect(ECP_CMD_POKE, 1, q, sizeof(*q) + 3, ECP_RES_INVALID_PARAM, &resp);

	/* Shorter than the address and count */
	ecp_test_expect(ECP_CMD_POKE, 1, q, sizeof(*q) - 1, ECP_RES_INVALID_COMMAND, &resp);

	zassert_mem_equal(target, before, sizeof(target), "Invalid request wrote memory");
}

ZTEST_SUITE(ecp_peek_poke, ecp_phase_any, NULL, peek_poke_before, NULL, NULL);
```

## src/test_system.c
```c
/*
 * Commands available in both the unconfigured and active states
 */
#include <string.h>

#include <zephyr/ztest.h>
#include <zephyr/sys/byteorder.h>
#include <zephyr/app_version.h>

#include "ecp_test.h"

static struct ecp_sim_response resp;

ZTEST(ecp_system, test_proto_version)
{
	ecp_test_expect(ECP_CMD_PROTO_VERSION, 2, NULL, 0, ECP_RES_SUCCESS, &resp);
	zassert_equal(resp.data_len, sizeof(struct ecp_response_proto_version));

	struct ecp_response_proto_version r;
	memcpy(&r, resp.data, sizeof(r));
	zassert_equal(r.versions, BIT(ECP_PROTO_VERSION));
	zassert_equal(r.flags, ECP_PROTOCOL_INFO_IN_PROGRESS_SUPPORTED);
}

ZTEST(ecp_system, test_proto_version_unsupported_version)
{
	ecp_test_expect(ECP_CMD_PROTO_VERSION, 1, NULL, 0, ECP_RES_UNSUPPORTED_CMD_VERSION, &resp);
}

/* The host sizes requests using the advertised maximums, so they must actually work */
ZTEST(ecp_system, test_proto_version_max_sizes_usable)
{
	static uint8_t data[ECP_MAX_PAYLOAD_BYTES];
	const size_t overhead = ECP_REQUEST_HEADER_SIZE + ECP_DATA_CRC_SIZE;

	ecp_test_expect(ECP_CMD_PROTO_VERSION, 2, NULL, 0, ECP_RES_SUCCESS, &resp);

	struct ecp_response_proto_version r;
	memcpy(&r, resp.data, sizeof(r));
	zassert_true(r.max_request_packet_size > overhead);
	zassert_true(r.max_response_packet_size > overhead);

	size_t len = MIN(r.max_request_packet_size, r.max_response_packet_size) - overhead;
	zassert_true(len <= sizeof(data), "Advertised size %zu exceeds the protocol limit %u", len,
		     ECP_MAX_PAYLOAD_BYTES);

	for (size_t i = 0; i < len; i++) {
		data[i] = i * 7;
	}
	ecp_test_expect(ECP_CMD_ECHO, 1, data, len, ECP_RES_SUCCESS, &resp);
	zassert_equal(resp.data_len, len);
	zassert_mem_equal(resp.data, data, len);
}

ZTEST(ecp_system, test_features)
{
	ecp_test_expect(ECP_CMD_FEATURES, 1, NULL, 0, ECP_RES_SUCCESS, &resp);
	zassert_equal(resp.data_len, sizeof(struct ecp_response_features));

	uint32_t expected =
		COND_CODE_1(CONFIG_APP_ECP_IO, (ECP_FEATURE_CH_IO), (0)) |
		COND_CODE_1(CONFIG_APP_ECP_PEEK_POKE, (ECP_FEATURE_PEEK_POKE), (0)) |
		COND_CODE_1(CONFIG_APP_ECP_GPIO, (ECP_FEATURE_GPIO), (0)) |
		COND_CODE_1(CONFIG_APP_ECP_DEVICE_EVENTS, (ECP_FEATURE_DEVICE_EVENT), (0)) |
		COND_CODE_1(CONFIG_APP_ECP_COMM_STATS, (ECP_FEATURE_COMM_STATS), (0)) |
		COND_CODE_1(CONFIG_APP_ECP_LED, (ECP_FEATURE_LED), (0));
	zassert_equal(sys_get_le32(resp.data), expected, "flags=0x%08x expected 0x%08x",
		      sys_get_le32(resp.data), expected);
}

ZTEST(ecp_system, test_ident)
{
	struct ecp_request_ident q = {.major = 1, .sw_part_number = "45116-560"};

	ecp_test_expect(ECP_CMD_IDENT, 1, &q, sizeof(q), ECP_RES_SUCCESS, &resp);
	zassert_equal(resp.data_len, sizeof(struct ecp_response_ident));

	struct ecp_response_ident r;
	memcpy(&r, resp.data, sizeof(r));
	zassert_equal(r.major, APP_VERSION_MAJOR);
	zassert_equal(r.minor, APP_VERSION_MINOR);
	zassert_equal(r.patch, APP_PATCHLEVEL);
	zassert_equal(r.build, APP_TWEAK);
	zassert_mem_equal(r.sw_part_number, CONFIG_APP_ECP_SW_PART_NUMBER,
			  sizeof(CONFIG_APP_ECP_SW_PART_NUMBER));
}

/* A complete request with less data than the command needs */
ZTEST(ecp_system, test_ident_request_too_small)
{
	struct ecp_request_ident q = {0};

	ecp_test_expect(ECP_CMD_IDENT, 1, &q, sizeof(q) - 1, ECP_RES_INVALID_PARAM, &resp);
}

ZTEST(ecp_system, test_hello)
{
	struct ecp_request_hello q = {.in_data = 0xFFFFFFF0};

	ecp_test_expect(ECP_CMD_HELLO, 1, &q, sizeof(q), ECP_RES_SUCCESS, &resp);
	zassert_equal(resp.data_len, sizeof(struct ecp_response_hello));
	/* Wraps around */
	zassert_equal(sys_get_le32(resp.data), 0xFFFFFFF0 + 0x01020304);
}

/* A complete request with less data than the command needs */
ZTEST(ecp_system, test_hello_request_too_small)
{
	struct ecp_request_hello q = {0};

	ecp_test_expect(ECP_CMD_HELLO, 1, &q, sizeof(q) - 1, ECP_RES_INVALID_PARAM, &resp);
}

ZTEST(ecp_system, test_echo)
{
	static uint8_t data[ECP_MAX_PAYLOAD_BYTES];
	const uint16_t lengths[] = {0, 1, 2, 255, 256, ECP_MAX_PAYLOAD_BYTES};

	for (size_t i = 0; i < sizeof(data); i++) {
		data[i] = i ^ 0xA5;
	}

	ARRAY_FOR_EACH(lengths, i) {
		ecp_test_expect(ECP_CMD_ECHO, 1, data, lengths[i], ECP_RES_SUCCESS, &resp);
		zassert_equal(resp.data_len, lengths[i]);
		zassert_mem_equal(resp.data, data, lengths[i], "Length %u", lengths[i]);
	}
}

ZTEST(ecp_system, test_uptime)
{
	uint32_t before = k_uptime_get_32();

	ecp_test_expect(ECP_CMD_UPTIME, 1, NULL, 0, ECP_RES_SUCCESS, &resp);
	zassert_equal(resp.data_len, sizeof(struct ecp_response_uptime));

	struct ecp_response_uptime r;
	memcpy(&r, resp.data, sizeof(r));
	zassert_between_inclusive(r.uptime_ms, before, k_uptime_get_32());
	/* Values 0-7 are defined. native_sim can't tell, so it must use 0 (UNKNOWN). */
	zassert_equal(r.reset_reason, 0);
}

static void get_comm_stats(struct ecp_response_comm_stats *stats)
{
	ecp_test_expect(ECP_CMD_COMM_STATS, 1, NULL, 0, ECP_RES_SUCCESS, &resp);
	zassert_equal(resp.data_len, sizeof(*stats));
	memcpy(stats, resp.data, sizeof(*stats));
}

ZTEST(ecp_system, test_comm_stats)
{
	Z_TEST_SKIP_IFNDEF(CONFIG_APP_ECP_COMM_STATS);

	struct ecp_response_comm_stats before, after;
	static uint8_t frame[64];

	get_comm_stats(&before);

	/* One request that fails, and one duplicate */
	ecp_test_expect(ECP_CMD_RESERVED, 1, NULL, 0, ECP_RES_INVALID_COMMAND, &resp);

	struct ecp_request_hello q = {0};
	size_t len = ecp_sim_host_build_request(frame, sizeof(frame), ECP_CMD_HELLO, 1, 3, false,
						&q, sizeof(q));
	ecp_sim_host_send_raw(frame, len, &resp);
	len = ecp_sim_host_build_request(frame, sizeof(frame), ECP_CMD_HELLO, 1, 3, true, &q,
					 sizeof(q));
	ecp_sim_host_send_raw(frame, len, &resp);
	zassert_true(resp.seq_dup);

	get_comm_stats(&after);

	/* The 3 requests above, plus the request for the stats themselves */
	zassert_equal(after.request_count - before.request_count, 4);
	zassert_equal(after.error_count - before.error_count, 1);
	zassert_equal(after.dup_count - before.dup_count, 1);
	zassert_equal(after.request_bytes - before.request_bytes,
		      ECP_REQUEST_HEADER_SIZE +
			      2 * (ECP_REQUEST_HEADER_SIZE + sizeof(q) + ECP_DATA_CRC_SIZE) +
			      ECP_REQUEST_HEADER_SIZE);
	zassert_true(after.response_bytes > before.response_bytes);
}

/* Commands for features that are disabled must be rejected */
ZTEST(ecp_system, test_disabled_features)
{
	const struct {
		bool enabled;
		uint16_t command;
	} commands[] = {
		{IS_ENABLED(CONFIG_APP_ECP_PEEK_POKE), ECP_CMD_PEEK},
		{IS_ENABLED(CONFIG_APP_ECP_PEEK_POKE), ECP_CMD_POKE},
		{IS_ENABLED(CONFIG_APP_ECP_GPIO), ECP_CMD_GPIO_CONFIG},
		{IS_ENABLED(CONFIG_APP_ECP_GPIO), ECP_CMD_GPIO},
		{IS_ENABLED(CONFIG_APP_ECP_COMM_STATS), ECP_CMD_COMM_STATS},
		{IS_ENABLED(CONFIG_APP_ECP_LED), ECP_CMD_LED_COLOR},
		{IS_ENABLED(CONFIG_APP_ECP_LED), ECP_CMD_LED_BRIGHTNESS},
		{IS_ENABLED(CONFIG_APP_ECP_DEVICE_EVENTS), ECP_CMD_DEVICE_EVENT},
	};

	ARRAY_FOR_EACH_PTR(commands, c) {
		if (!c->enabled) {
			ecp_test_expect(c->command, 1, NULL, 0, ECP_RES_INVALID_COMMAND, &resp);
		}
	}
}

ZTEST_SUITE(ecp_system, ecp_phase_any, NULL, NULL, NULL, NULL);
```

## src/test_watchdog.c
```c
/*
 * Task watchdog: the command handler and the port handler keep feeding their channels
 * while the host is silent. If either stopped, the task watchdog would reset the ECP and
 * the test would never finish.
 */
#include <zephyr/ztest.h>

#include <dp/drivers/port.h>

#include "ecp_test.h"

static struct ecp_sim_response resp;

ZTEST(ecp_task_wdt, test_threads_feed_while_host_silent)
{
	k_msleep(5 * MAX(CONFIG_ECP_DEVICE_CMD_TASK_WDT_TIMEOUT_MS,
			 CONFIG_DP_PORTS_TASK_WDT_TIMEOUT_MS));

	struct ecp_request_io_read q = {.ch = PORT_CH_A};

	ecp_test_expect(ECP_CMD_IO_READ, 2, &q, sizeof(q), ECP_RES_SUCCESS, &resp);
}

/* After ENUM, so the port handler is running too */
ZTEST_SUITE(ecp_task_wdt, ecp_phase_active, NULL, NULL, NULL, NULL);
```
