## CMakeLists.txt
```
cmake_minimum_required(VERSION 3.20.0)

# Use the application's native_sim stand-ins for the ECP hardware
set(DTC_OVERLAY_FILE ${CMAKE_CURRENT_SOURCE_DIR}/../../boards/native_sim.overlay)

find_package(Zephyr REQUIRED HINTS $ENV{ZEPHYR_BASE})
project(ecp_fuzz)

set(APP_DIR ${CMAKE_CURRENT_SOURCE_DIR}/../..)

# Code under test
target_sources(app PRIVATE ${APP_DIR}/src/commands.c ${APP_DIR}/src/bindesc_dp.c)

target_sources(app PRIVATE src/main.c)
```

## Kconfig
```
config ECP_FUZZ_IRQ
	int "Interrupt used to deliver fuzz inputs"
	default 31

config ECP_FUZZ_MAX_FRAMES
	int "Maximum number of frames in one fuzz input"
	default 16

# The application's options (APP_ECP_*), which also sources Kconfig.zephyr
rsource "../../Kconfig"
```

## prj.conf
```kconfig
CONFIG_ARCH_POSIX_LIBFUZZER=y
CONFIG_ASAN=y
CONFIG_UBSAN=y
CONFIG_ASSERT=y

CONFIG_ECP_DEVICE_CMD_BACKEND_SIMULATOR=y
CONFIG_ECP_DEVICE_CMD_DEDICATED_THREAD=y
CONFIG_ECP_DEVICE_CMD_IN_PROGRESS_STATUS=y

# On native_sim, PEEK and POKE accept any address, so random inputs would crash in
# them. On the target, they're limited to valid memory ranges.
CONFIG_APP_ECP_PEEK_POKE=n

CONFIG_GPIO=y
CONFIG_EVENTS=y
CONFIG_REBOOT=y
CONFIG_DP_METRICS=y

CONFIG_BINDESC=y
CONFIG_BINDESC_DEFINE=y
CONFIG_BINDESC_DEFINE_VERSION=y
CONFIG_BINDESC_DP_SW_PART_NUMBER=y

# Match the application: the port handler thread is started by ENUM
CONFIG_DP_PORTS_HANDLER_DEDICATED_THREAD=n

# Logging every rejected frame slows fuzzing down
CONFIG_LOG=n
```

## src/main.c
```c
/*
 * libFuzzer target for the ECP device command handler and the application's commands.
 *
 * Each fuzz input is a sequence of frames, sent to the ECP one at a time through the
 * simulator backend. Each frame is encoded as:
 *
 *   uint8_t flags;    // FRAME_FIX_CRCS: fill in valid header and data CRCs
 *   uint16_t length;  // little endian
 *   uint8_t data[length];
 *
 * so the fuzzer can reach the command handlers without having to find valid CRCs.
 *
 * After each frame, the ECP must send a correctly framed response. If it doesn't, or a
 * sanitizer or assertion fails, the input is reported as a crash.
 */
#include <stdlib.h>
#include <string.h>

#include <zephyr/kernel.h>
#include <zephyr/irq.h>
#include <zephyr/sys/byteorder.h>
#include <irq_ctrl.h>
#include <nsi_cpu_if.h>
#include <nsi_main_semipublic.h>

#include <dp/ecp/protocol.h>
#include <dp/ecp/ecp_device_cmd/backend.h>
#include <dp/ecp/ecp_device_cmd/simulator.h>

#define FRAME_FIX_CRCS BIT(0)

/* Upper bound on simulated time to handle one input, to detect hangs */
#define INPUT_TIMEOUT_MS 1000

static const uint8_t *fuzz_data;
static size_t fuzz_len;
static volatile bool input_done;

static K_SEM_DEFINE(input_ready, 0, 1);
static K_SEM_DEFINE(response_ready, 0, 1);
static struct ecp_device_cmd_response_ctx *rctx;
static uint8_t frame[CONFIG_ECP_DEVICE_CMD_HANDLER_RX_BUFFER_SIZE + 1];

static void fail(const char *why)
{
	printk("ECP fuzz failure: %s\n", why);
	abort();
}

static int host_receive(const struct ecp_device_cmd_backend *backend)
{
	ARG_UNUSED(backend);

	k_sem_give(&response_ready);
	return 0;
}

static void check_response(const uint8_t *request, size_t request_len)
{
	const struct ecp_response_header *header = (void *)rctx->buf;

	if (rctx->len < ECP_RESPONSE_HEADER_SIZE || rctx->len > rctx->len_max) {
		fail("response length out of range");
	}
	if (ecp_crc8(header, ECP_RESPONSE_HEADER_SIZE) != 0) {
		fail("bad response header CRC");
	}
	if (FIELD_GET(ECP_STRUCT_VERSION_MASK, header->flags) != ECP_PROTO_VERSION ||
	    !FIELD_GET(ECP_IS_RESPONSE_MASK, header->flags) || header->_unused != 0) {
		fail("bad response header flags");
	}

	uint16_t data_len = FIELD_GET(ECP_DATA_LENGTH_MASK, header->data_len);
	size_t expected = ECP_RESPONSE_HEADER_SIZE + (data_len ? data_len + ECP_DATA_CRC_SIZE : 0);

	if (rctx->len != expected) {
		fail("response length doesn't match header");
	}
	if (data_len > 0 &&
	    ecp_crc16(rctx->buf + ECP_RESPONSE_HEADER_SIZE, data_len + ECP_DATA_CRC_SIZE) != 0) {
		fail("bad response data CRC");
	}
	if (data_len > 0 && header->result != ECP_RES_SUCCESS &&
	    header->result != ECP_RES_IN_PROGRESS) {
		fail("error response has data");
	}

	/* Every response echoes the request's sequence number and duplicate flag */
	const uint8_t echoed = ECP_SEQ_NUM_MASK | ECP_SEQ_DUP_MASK;

	if (request_len > 0 && (header->flags & echoed) != (request[0] & echoed)) {
		fail("response doesn't echo the request's sequence number");
	}
}

static void fix_crcs(uint8_t *buf, size_t len)
{
	struct ecp_request_header *header = (void *)buf;

	if (len < ECP_REQUEST_HEADER_SIZE) {
		return;
	}
	header->header_crc = ecp_crc8(header, ECP_REQUEST_HEADER_SIZE_NO_CRC);

	uint16_t data_len = FIELD_GET(ECP_DATA_LENGTH_MASK, header->data_len);
	if (data_len > 0 && len >= ECP_REQUEST_HEADER_SIZE + data_len + ECP_DATA_CRC_SIZE) {
		uint8_t *data = buf + ECP_REQUEST_HEADER_SIZE;
		sys_put_be16(ecp_crc16(data, data_len), data + data_len);
	}
}

/* Commands that would end or wedge the fuzzing process */
static bool skip_frame(const uint8_t *buf, size_t len)
{
	if (len < ECP_REQUEST_HEADER_SIZE) {
		return false;
	}
	uint16_t command = sys_get_le16(&buf[offsetof(struct ecp_request_header, command)]);

	switch (command) {
	case ECP_CMD_REBOOT:
	case ECP_CMD_BOOT_JUMP:
		/* Restart the ECP (and exit the process) */
		return true;
	default:
		return false;
	}
}

static void send_frame(uint8_t flags, const uint8_t *data, size_t len)
{
	len = MIN(len, sizeof(frame));
	memcpy(frame, data, len);
	if (flags & FRAME_FIX_CRCS) {
		fix_crcs(frame, len);
	}
	if (skip_frame(frame, len)) {
		return;
	}

	k_sem_reset(&response_ready);
	if (ecp_device_cmd_backend_sim_data_received(frame, len) != 0) {
		/* Rejected by the backend (too long), so there's no response */
		if (len <= CONFIG_ECP_DEVICE_CMD_HANDLER_RX_BUFFER_SIZE) {
			fail("backend rejected a frame that fits");
		}
		return;
	}
	if (k_sem_take(&response_ready, K_MSEC(INPUT_TIMEOUT_MS)) != 0) {
		fail("no response");
	}
	check_response(frame, len);
}

static void run_input(const uint8_t *data, size_t len)
{
	for (int i = 0; i < CONFIG_ECP_FUZZ_MAX_FRAMES && len >= 3; i++) {
		uint8_t flags = data[0];
		size_t frame_len = MIN(sys_get_le16(&data[1]), len - 3);

		send_frame(flags, &data[3], frame_len);
		data += 3 + frame_len;
		len -= 3 + frame_len;
	}
}

/* Make sure the ECP is active, even if the last input sent ESTOP */
static void enumerate(void)
{
	const struct ecp_request_enum q = {.ecp_type = ECP_TYPE_DO_DI_5A, .ecp_revision = 2};
	struct ecp_request_header *header = (void *)frame;

	header->flags = FIELD_PREP(ECP_STRUCT_VERSION_MASK, ECP_PROTO_VERSION);
	header->command = ECP_CMD_ENUM;
	header->data_len = FIELD_PREP(ECP_DATA_LENGTH_MASK, sizeof(q)) |
			   FIELD_PREP(ECP_REQ_COMMAND_VERSION_MASK, 1);
	memcpy(&frame[ECP_REQUEST_HEADER_SIZE], &q, sizeof(q));
	size_t len = ECP_REQUEST_HEADER_SIZE + sizeof(q) + ECP_DATA_CRC_SIZE;
	fix_crcs(frame, len);

	k_sem_reset(&response_ready);
	ecp_device_cmd_backend_sim_data_received(frame, len);
	if (k_sem_take(&response_ready, K_MSEC(INPUT_TIMEOUT_MS)) != 0) {
		fail("no response to ENUM");
	}

	/* NOT_ALLOWED if already active */
	uint8_t result = rctx->buf[offsetof(struct ecp_response_header, result)];
	if (result != ECP_RES_SUCCESS && result != ECP_RES_NOT_ALLOWED) {
		fail("ENUM failed");
	}
}

static void fuzz_isr(const void *arg)
{
	ARG_UNUSED(arg);

	k_sem_give(&input_ready);
}

int main(void)
{
	ecp_device_cmd_backend_sim_install_send_cb(host_receive, &rctx);

	IRQ_CONNECT(CONFIG_ECP_FUZZ_IRQ, 0, fuzz_isr, NULL, 0);
	irq_enable(CONFIG_ECP_FUZZ_IRQ);

	while (true) {
		k_sem_take(&input_ready, K_FOREVER);

		/* Start each input in the active state, where most commands are available */
		enumerate();
		run_input(fuzz_data, fuzz_len);
		input_done = true;
	}
	return 0;
}

/* Called by libFuzzer, outside of Zephyr, for each input */
NATIVE_SIMULATOR_IF
int LLVMFuzzerTestOneInput(const uint8_t *data, size_t len)
{
	static bool initialized;

	if (!initialized) {
		nsi_init(0, NULL);
		initialized = true;
	}

	fuzz_data = data;
	fuzz_len = len;
	input_done = false;
	hw_irq_ctrl_set_irq(CONFIG_ECP_FUZZ_IRQ);

	/* Run the simulation until the input is handled. libFuzzer frees the input when
	 * this function returns, so it must not be used after that.
	 */
	for (int ms = 0; !input_done; ms++) {
		if (ms > INPUT_TIMEOUT_MS * CONFIG_ECP_FUZZ_MAX_FRAMES) {
			fail("input not handled");
		}
		nsi_exec_for(1000);
	}

	return 0;
}
```
